static const char BLE_PUB_KEY[] =
    "-----BEGIN PUBLIC KEY-----
"
    "MIIBIjANBgkqhkiG9w0BAQEFAAOCAQ8AMIIBCgKCAQEAq39sK0dQPzfrWthyi3Xy
"
    "GQVOQDpmxfeqArafDe0lGutY8mfluE1kuHdZwuNhIeXip+Hmacyw1md36zR93V2D
"
    "kSrdDYrm+SI5pg4QCob0vLpqzERTSrKHPJHRuD0PVePx6TZpgEg4orwsuTBPvJzb
"
    "h18qMOYGCAk0MZY2XveLc/nPDT1lYeGjcdj7cCHuUjvFlPLYMxRjmrAom2jt9ZpK
"
    "P01qHiGg5N2NAy1FTqEmTN+roN8/mv+BFNySDJhxYoTxStqB3ZTaTdx+Gxa3qX/S
"
    "Dq8NlXGGbCQNBmU2PU8Q/aNdjB//n1IcRBcigLA7BQWwy6O7w0p+kRXhN3eZpcvO
"
    "ywIDAQAB
"
    "-----END PUBLIC KEY-----
";

static const char SVR_PUB_KEY[] =
    "-----BEGIN PUBLIC KEY-----
"
    "MIIBIjANBgkqhkiG9w0BAQEFAAOCAQ8AMIIBCgKCAQEApiXcbaLdBACI3yOGLDuD
"
    "VBFPHC3NwZm/xVTVPUjwaxFoLxhMAXplehqUJd+Qd+K/g01B8h4pplkhpJZktLBe
"
    "LC9nW5E97Jjw6sVqqneDuaGbwMyfio/qclsmkLUhY+zJdDEVm2OGowLE8QnggPPb
"
    "Eq+MKSOnqZWRs/NLwRJsVj432KTehEXlx8BzV43WGfz6bb0SlEct7cCpXXzXcT7P
"
    "oBAbGcJizzO8zkYxEWhvPnoBVuDubCl4sMkF6wwYWaBuxqT2b0H3vBE3pXGeovdx
"
    "9hAo2yQQYtqeL+IRomv5bhFkoWKAX2S7g2oo5lbqfbqZnNTucNB9jpRv8Ods0Tq5
"
    "dQIDAQAB
"
    "-----END PUBLIC KEY-----
";
